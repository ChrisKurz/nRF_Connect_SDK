## Workspace/NCSv2.6.0/ZHW_UART_1/build/Kconfig/Kconfig.shield
```kconfig
osource "c:/nordic/myboards/boards/shields/*/Kconfig.shield"
osource "C:/Nordic/NCS/v2.6.0/nrf/boards/shields/*/Kconfig.shield"
```

## Workspace/NCSv2.6.0/ZHW_UART_1/build/Kconfig/Kconfig.shield.defconfig
```kconfig
osource "c:/nordic/myboards/boards/shields/*/Kconfig.defconfig"
osource "C:/Nordic/NCS/v2.6.0/nrf/boards/shields/*/Kconfig.defconfig"
```
